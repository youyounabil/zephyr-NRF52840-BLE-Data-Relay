## CMakeLists.txt
```
#
# Copyright (c) 2020 Nordic Semiconductor ASA
#
# SPDX-License-Identifier: LicenseRef-Nordic-5-Clause
#
cmake_minimum_required(VERSION 3.20.0)

find_package(Zephyr REQUIRED HINTS $ENV{ZEPHYR_BASE})
project(peripheral_hr_coded)

# NORDIC SDK APP START
target_sources(app PRIVATE
  src/main.c
)
# NORDIC SDK APP END
```

## Kconfig.sysbuild
```
#
# Copyright (c) 2023 Nordic Semiconductor
#
# SPDX-License-Identifier: LicenseRef-Nordic-5-Clause
#

source "${ZEPHYR_BASE}/share/sysbuild/Kconfig"

config NRF_DEFAULT_IPC_RADIO
	default y
```

## sample.yaml
```
sample:
  description: Bluetooth Low Energy peripheral heart rate service connecting on LE
    Coded PHY
  name: Bluetooth LE peripheral HR Coded
tests:
  sample.bluetooth.peripheral_hr_coded:
    sysbuild: true
    build_only: true
    integration_platforms:
      - nrf52840dk/nrf52840
      - nrf5340dk/nrf5340/cpuapp
      - nrf54h20dk/nrf54h20/cpuapp
    platform_allow: nrf52840dk/nrf52840 nrf5340dk/nrf5340/cpuapp nrf54h20dk/nrf54h20/cpuapp
    tags: bluetooth ci_build sysbuild
```

## prj.conf
```kconfig
# #
# # Copyright (c) 2020 Nordic Semiconductor
# #
# # SPDX-License-Identifier: LicenseRef-Nordic-5-Clause
# #

# CONFIG_NCS_SAMPLES_DEFAULTS=y
# CONFIG_DK_LIBRARY=y

# CONFIG_BT=y
# CONFIG_BT_DEBUG_LOG=y
# CONFIG_BT_PERIPHERAL=y
# CONFIG_BT_DEVICE_NAME="Nordic_Peripheral"
# CONFIG_BT_BAS=y
# CONFIG_BT_HRS=y

# CONFIG_BT_CTLR_PHY_CODED=y
# CONFIG_BT_CTLR_ADV_EXT=y

# CONFIG_BT_EXT_ADV=y
# CONFIG_BT_USER_PHY_UPDATE=y

# CONFIG_BT_LBS=y
# CONFIG_BT_LBS_POLL_BUTTON=y

# CONFIG_BT_GATT_SERVICE_CHANGED=y

# #
# # Copyright (c) 2018 Nordic Semiconductor
# #
# # SPDX-License-Identifier: LicenseRef-Nordic-5-Clause
# #

# # Enable the UART driver
# CONFIG_UART_ASYNC_API=y
# CONFIG_NRFX_UARTE0=y
# CONFIG_SERIAL=y

# CONFIG_GPIO=y

# # Make sure printk is printing to the UART console
# CONFIG_CONSOLE=y
# CONFIG_UART_CONSOLE=y

# CONFIG_HEAP_MEM_POOL_SIZE=2048

# CONFIG_BT=y
# CONFIG_BT_PERIPHERAL=y
# CONFIG_BT_MAX_CONN=1
# CONFIG_BT_MAX_PAIRED=1

# # Enable the NUS service
# # STEP 1 - Enable the Kconfig symbol of the NUS service
# CONFIG_BT_NUS=y

# # Enable bonding
# CONFIG_BT_SETTINGS=y
# CONFIG_FLASH=y
# CONFIG_FLASH_PAGE_LAYOUT=y
# CONFIG_FLASH_MAP=y

# # Enable DK LED and Buttons library
# CONFIG_DK_LIBRARY=y

# # This example requires more stack
# CONFIG_MAIN_STACK_SIZE=1152
# CONFIG_SYSTEM_WORKQUEUE_STACK_SIZE=2048

# # Config logger
# CONFIG_LOG=y
# CONFIG_USE_SEGGER_RTT=y
# CONFIG_LOG_BACKEND_RTT=y
# CONFIG_LOG_BACKEND_UART=n
# CONFIG_LOG_PRINTK=n

# CONFIG_ASSERT=y

# Bluetooth
CONFIG_BT=y
CONFIG_BT_CENTRAL=y
CONFIG_BT_PERIPHERAL=y
CONFIG_BT_GATT_CLIENT=y
CONFIG_BT=y
CONFIG_BT_PERIPHERAL=y
CONFIG_BT_CENTRAL=y   # (only if you need central role too)

CONFIG_BT_DEVICE_NAME="Nordic_Peripheral"

# Logging
CONFIG_LOG=y
CONFIG_LOG_DEFAULT_LEVEL=3

# GPIO / DK library
CONFIG_GPIO=y
CONFIG_DK_LIBRARY=y
```

## boards/nrf5340dk_nrf5340_cpuapp.conf
```kconfig
#
# Copyright (c) 2022 Nordic Semiconductor
#
# SPDX-License-Identifier: LicenseRef-Nordic-5-Clause
#

# Application core does not have BLE controller. Disable controller related options.
CONFIG_BT_CTLR_PHY_CODED=n
CONFIG_BT_CTLR_ADV_EXT=n
```

## boards/nrf54h20dk_nrf54h20_cpuapp.conf
```kconfig
#
# Copyright (c) 2024 Nordic Semiconductor
#
# SPDX-License-Identifier: LicenseRef-Nordic-5-Clause
#

# Application core does not have BLE controller. Disable controller related options.
CONFIG_BT_CTLR_PHY_CODED=n
CONFIG_BT_CTLR_ADV_EXT=n
```

## src/main.c
```c
#include <zephyr/kernel.h>
#include <zephyr/logging/log.h>
#include <zephyr/bluetooth/bluetooth.h>
#include <zephyr/bluetooth/gap.h>
#include <zephyr/bluetooth/gatt.h>
#include <dk_buttons_and_leds.h>
#include <string.h>

#define RUN_STATUS_LED DK_LED1
#define CONNECTION_STATUS_LED DK_LED2
#define RUN_LED_BLINK_INTERVAL 500

static struct bt_conn *my_conn = NULL;
char received_data[100] = {0};
static bool new_data_flag = false; // flag for new data

LOG_MODULE_REGISTER(peripheral_app, LOG_LEVEL_INF);

// ---------------- CUSTOM UUIDs ----------------
// Custom Service UUID: 12345678-1234-5678-1234-123456789abc
/* Custom Service UUID: 12345678-1234-5678-1234-123456789abc */
static struct bt_uuid_128 custom_service_uuid = BT_UUID_INIT_128(
	0xbc, 0x9a, 0x78, 0x56,
	0x34, 0x12, 0x78, 0x56,
	0x34, 0x12, 0x34, 0x12,
	0x78, 0x56, 0x34, 0x12
);

/* Custom Characteristic UUID: abcdefab-cdef-4567-89ab-cdef12345678 */
static struct bt_uuid_128 custom_char_uuid = BT_UUID_INIT_128(
   0x78, 0x56, 0x34, 0x12,
    0xef, 0xcd, 0xab, 0x89,
    0x67, 0x45, 0xef, 0xcd,
    0xab, 0xef, 0xcd, 0xab
);


// ---------------- GATT HANDLERS ----------------
static ssize_t write_data(struct bt_conn *conn,
                          const struct bt_gatt_attr *attr,
                          const void *buf, uint16_t len,
                          uint16_t offset, uint8_t flags)
{
    uint16_t copy_len = MIN(len, sizeof(received_data) - 1);

    memcpy(received_data, buf, copy_len);
    received_data[copy_len] = '\0'; // null terminate

    new_data_flag = true; // mark new data arrived

    return len;
}

BT_GATT_SERVICE_DEFINE(custom_svc,
    BT_GATT_PRIMARY_SERVICE(&custom_service_uuid),
    BT_GATT_CHARACTERISTIC(&custom_char_uuid.uuid,
                           BT_GATT_CHRC_WRITE | BT_GATT_CHRC_WRITE_WITHOUT_RESP,
                           BT_GATT_PERM_WRITE,
                           NULL, write_data, NULL),
);

// ---------------- ADVERTISING ----------------
static const struct bt_data ad[] = {
    BT_DATA_BYTES(BT_DATA_FLAGS, (BT_LE_AD_GENERAL | BT_LE_AD_NO_BREDR)),
    BT_DATA(BT_DATA_NAME_COMPLETE, "Nordic_Peripheral", 17),
};

static const struct bt_data sd[] = {
    BT_DATA_BYTES(BT_DATA_UUID128_ALL,
                  0x9c,0xab,0x78,0x56,0x34,0x12,0x34,0x12,
                  0x78,0x56,0x34,0x12,0x78,0x56,0x34,0x12)
};

// ---------------- CONNECTION HANDLERS ----------------
void on_connected(struct bt_conn *conn, uint8_t err)
{
    if (err) {
        LOG_ERR("Connection error %d", err);
        return;
    }

    LOG_INF("Connected");
    my_conn = bt_conn_ref(conn);
    dk_set_led(CONNECTION_STATUS_LED, 1);
}

void on_disconnected(struct bt_conn *conn, uint8_t reason)
{
    LOG_INF("Disconnected. Reason %d", reason);
    if (my_conn) {
        bt_conn_unref(my_conn);
        my_conn = NULL;
    }
    dk_set_led(CONNECTION_STATUS_LED, 0);
}

struct bt_conn_cb conn_callbacks = {
    .connected = on_connected,
    .disconnected = on_disconnected,
};

// ---------------- MAIN ----------------
int main(void)
{
    int blink_status = 0;
    int err;

    LOG_INF("Starting Peripheral Example");

    err = dk_leds_init();
    if (err) {
        LOG_ERR("LEDs init failed (err %d)", err);
        return -1;
    }

    bt_conn_cb_register(&conn_callbacks);

    err = bt_enable(NULL);
    if (err) {
        LOG_ERR("Bluetooth init failed (err %d)", err);
        return -1;
    }

    LOG_INF("Bluetooth initialized");

    static const struct bt_le_adv_param adv_param = {
        .options = BT_LE_ADV_OPT_CONNECTABLE,
        .interval_min = BT_GAP_ADV_FAST_INT_MIN_1,
        .interval_max = BT_GAP_ADV_FAST_INT_MAX_1,
        .id = BT_ID_DEFAULT,
    };

    err = bt_le_adv_start(&adv_param, ad, ARRAY_SIZE(ad), sd, ARRAY_SIZE(sd));
    if (err) {
        LOG_ERR("Advertising failed to start (err %d)", err);
        return -1;
    }

    LOG_INF("Advertising successfully started");

    for (;;) {
        // Blink RUN LED
        dk_set_led(RUN_STATUS_LED, (++blink_status) % 2);

        // Always check for new data
        if (new_data_flag) {
            printk("📩 New data received from central: %s\n", received_data);
            new_data_flag = false; // reset flag
        }

        k_sleep(K_MSEC(RUN_LED_BLINK_INTERVAL));
    }
}
```
